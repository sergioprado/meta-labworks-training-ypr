## conf/layer.conf
```bitbake
# We have a conf and classes directory, add to BBPATH
BBPATH .= ":${LAYERDIR}"

# We have recipes-* directories, add to BBFILES
BBFILES += " \
    ${LAYERDIR}/recipes-*/*/*.bb \
    ${LAYERDIR}/recipes-*/*/*.bbappend \
"

BBFILE_COLLECTIONS += "labworks"
BBFILE_PATTERN_labworks = "^${LAYERDIR}/"
BBFILE_PRIORITY_labworks = "10"

BBFILES_DYNAMIC += " \
    freescale-3rdparty:${LAYERDIR}/dynamic-layers/freescale-3rdparty/recipes-*/*/*.bb \
    freescale-3rdparty:${LAYERDIR}/dynamic-layers/freescale-3rdparty/recipes-*/*/*.bbappend \
"

LAYERSERIES_COMPAT_labworks = "kirkstone"
```
